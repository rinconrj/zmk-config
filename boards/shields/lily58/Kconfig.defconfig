## boards/shields/lily58/Kconfig.defconfig
```kconfig
# Copyright (c) 2024 The ZMK Contributors
# SPDX-License-Identifier: MIT

# HID
if ZMK_HID_REPORT_TYPE_HKRO

config ZMK_HID_KEYBOARD_REPORT_SIZE
    default 6

endif

config ZMK_HID_CONSUMER_REPORT_SIZE
    default 6

# Behaviors

if ZMK_BEHAVIOR_HOLD_TAP

config ZMK_BEHAVIOR_HOLD_TAP_MAX_HELD
    default 10

config ZMK_BEHAVIOR_HOLD_TAP_MAX_CAPTURED_EVENTS
    default 40

endif

if ZMK_BEHAVIOR_STICKY_KEY

config ZMK_BEHAVIOR_STICKY_KEY_MAX_HELD
    default 10

endif

if ZMK_BEHAVIOR_TAP_DANCE

config ZMK_BEHAVIOR_TAP_DANCE_MAX_HELD
    default 10

endif

# Underglow
if ZMK_RGB_UNDERGLOW

# This default value cuts down on tons of excess .conf files, if you're using GPIO, manually disable this
config SPI
    default y

config ZMK_RGB_UNDERGLOW_EXT_POWER
    default y

config ZMK_RGB_UNDERGLOW_BRT_MIN
    default 0

config ZMK_RGB_UNDERGLOW_BRT_MAX
    default 100

config ZMK_RGB_UNDERGLOW_HUE_STEP
    default 10

config ZMK_RGB_UNDERGLOW_SAT_STEP
    default 10

config ZMK_RGB_UNDERGLOW_BRT_STEP
    default 10

config ZMK_RGB_UNDERGLOW_HUE_START
    default 0

config ZMK_RGB_UNDERGLOW_SAT_START
    default 100

config ZMK_RGB_UNDERGLOW_BRT_START
    default ZMK_RGB_UNDERGLOW_BRT_MAX

config ZMK_RGB_UNDERGLOW_SPD_START
    default 3

config ZMK_RGB_UNDERGLOW_EFF_START
    default 0

config ZMK_RGB_UNDERGLOW_ON_START
    default y

endif # ZMK_RGB_UNDERGLOW

# Backlight
if ZMK_BACKLIGHT

config ZMK_BACKLIGHT_BRT_STEP
    default 20

config ZMK_BACKLIGHT_BRT_START
    default 40

config ZMK_BACKLIGHT_ON_START
    default y

endif # ZMK_BACKLIGHT

# Ext_power
config ZMK_EXT_POWER
    default y

# Battery
config ZMK_BATTERY_REPORT_INTERVAL
    default 60

if ZMK_BLE

if ZMK_SPLIT_BLE && ZMK_SPLIT_ROLE_CENTRAL

config ZMK_SPLIT_BLE_CENTRAL_PERIPHERALS
    default 1

config BT_MAX_CONN
    default 6

config BT_MAX_PAIRED
    default 6

#ZMK_SPLIT_BLE && ZMK_SPLIT_ROLE_CENTRAL
endif

if !ZMK_SPLIT_BLE

config BT_MAX_CONN
    default 5

config BT_MAX_PAIRED
    default 5

#!ZMK_SPLIT_BLE
endif

#ZMK_BLE
endif

if ZMK_BACKLIGHT

config PWM
    default y

config LED_PWM
    default y

endif # ZMK_BACKLIGHT
```

## config/west.yml
```yaml
manifest:
  remotes:
    - name: zmkfirmware
      url-base: https://github.com/zmkfirmware
    # include corne with dongle pro_micro and xiao compatible
    - name: mctechnology17
      url-base: https://github.com/mctechnology17
  projects:
    - name: zmk
      remote: zmkfirmware
      revision: main
      import: app/west.yml
    # include corne with dongle pro_micro and xiao compatible
    - name: zmk-config
      remote: mctechnology17
      revision: main
  self:
    path: config
```
